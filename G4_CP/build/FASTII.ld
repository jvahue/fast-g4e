/*---------------------------------------------------------------------------------------------
            Copyright (C) 2007 - 2010 Pratt & Whitney Engine Services, Inc. 
                      Altair Engine Diagnostic Solutions
               All Rights Reserved. Proprietary and Confidential.


 File:        FASTII.ld

	!!!WARNING: DO NOT EDIT THIS FILE WITH THE GRAPHICAL LD EDITOR!!!!
	        It will obliterate all comments
		
 Description: Definition of the board memory and the memory sections that are allocated into
 	      the memories.  This file combines several Green Hills specific sections

          MEMORY:
            dram_memory
              Location for 32MB of SDRAM for the FAST II processor board.  It is IMPORTANT
              to note that this memory is not accessable until the SDRAM periperhal in initialized
              
            sram_memory
              Location for the 32kB of SRAM internal to the Coldfire Processor.  This memory is available
              at this location at startup.  
              
            pflash_memory
              Location for the main program flash memory.  Located on CS0 of the FlexBus, it is the
              first memory executed from at startup.  The FlexBus peripheral must be intialized to
              set optimal wait states and define the address mask for control of CS0.  This is
              typically already done by the bootloader.

            dflash_memory
              Location for the main data flash memory.  Located at CS1 of the FlexBus, it must be
              intialized before access.  Data flash is used by the bootloader, so it should already
              be initialized for access.  


	      
	      SECTIONS:
		In SDRAM:
	      .data = initialized data memory
	      .bss = uninitialized data memory
	      .pbss = data memory excluded from CBIT Ram Test

	      .zdata/.zbss NOT IMPLIMENTED - This special section is used by GHS to define
	      		   a special 64k or less, chunk of data based at 0x0 for faster access
			   Because this map puts ROM at 0x0, zdata is meaningless
 		In SRAM:
	      .sdabase, .sdadata, .sdabss  = Small data areas, this defines a 64k or
	      		 less chunk of data memory that can be accessed more efficiently
			 using 16-bit offset addressing.
          .stack = reserved section at the end of other dram data for STACK
          
	    In FLASH:
	      .vector = CPU exception vector table area that must start at the same address as VBR.
	      		(VBR (Vector Base Register) defaults to 0x0000 0000)
	      .text = general relocatable code area
	      .syscall = some silly section GHS uses for debugging and C runtime maintainence
	      .rodata = read-only data
	      .secinfo = a section used by the GHS C initialization to define what sections are
	      		 available and what sections to copy (such as copy rodata->data)
	      .crcDefault = a location to hold a default CRC value that is accepted during testing
	                    the final build will fill this location in with the actual program CRC

	      __ghs_XXXXXXX constants are used by the debugger somehow.
---------------------------------------------------------------------------------------------*/

CONSTANTS
{
	stack_reserve = 1M
}

MEMORY
{
	dram_memory    : ORIGIN = 0x30000000,	LENGTH = 32M-stack_reserve
    stack_mem      : ORIGIN = 0x31F00000,   LENGTH = stack_reserve
	sram_memory    : ORIGIN = 0x80010000,	LENGTH = 32K
	pflash_memory  : ORIGIN = 0x00100000,	LENGTH = 32M-1M
	dflash_memory  : ORIGIN = 0x10000000,	LENGTH = 256M
}

/*------------------------------------------------------------------------------------------ 
The section .pbss is used to protect variables used during non-maskable interrupts
from the CBIT Ram Test. This section is excluded from the ram test.

The section .crcDefault must be the last section in program space and is setup to hold
a default CRC value: 0xFFFFFFFF for debug or 0x00000000 for release.
The CRC algorithm accepts 0xFFFFFFFF as a valid CRC for testing purposes.
The value is initialized to 0x00000000 for release and must be reset to a valid value
by the ProgramID program before installation.
------------------------------------------------------------------------------------------*/
SECTIONS
{
  .bss                                   : > dram_memory
  .data                                  : > .
  .pbss                                  : > .

  .sdabase ALIGN(4)                      : > .
  .sbss                                  : > .
  .stackbase                             : > stack_mem
   __SP_END = .;
  .stack ALIGN(4) PAD (stack_reserve)    : > .
   __SP_INIT = .;

  .vector ALIGN(4)                       : > pflash_memory
  .text ALIGN(4)                         : > .
  .rodata                                : > .
	.secinfo                               : > .
	.fixaddr                               : > .
	.fixtype                               : > .
  .sdata                                 : > .
  .syscall                               : > .
  .ROM.data                   ROM(.data) : > .
  .crcDefault                            : > .
  .buildDate                             : > .
  
   __CRC_START = ADDR(.vector);
   __CRC_END = ENDADDR(.ROM.data);

	__ghs_cframstart = MEMADDR(sram_memory);
	__ghs_ramstart = MEMADDR(dram_memory);
	__ghs_ramend = MEMENDADDR(dram_memory);
	__ghs_allocatedramend = ENDADDR(.bss);
	__ghs_pramstart = ADDR(.pbss);
	__ghs_pramend = ENDADDR(.pbss);
	__ghs_romstart = 0;
	__ghs_romend = MEMENDADDR(pflash_memory);
	__ghs_rambootcodestart = 0;
	__ghs_rambootcodeend = 0;
	__ghs_rombootcodestart = ADDR(.text);
	__ghs_rombootcodeend = ENDADDR(.fixtype);
	
}
